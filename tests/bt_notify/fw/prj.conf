## CMakeLists.txt
```
#
# Copyright (c) 2022 Nordic Semiconductor
#
# SPDX-License-Identifier: LicenseRef-Nordic-5-Clause
#
cmake_minimum_required(VERSION 3.20.0)

find_package(Zephyr REQUIRED HINTS $ENV{ZEPHYR_BASE})
project(bt_notify)

target_sources(app PRIVATE
  src/main.c
  src/rpc_handler.c
  src/nih_rpc.c
  src/nih_rpc_log_backend.c
)

# Needed for rpc_opcodes.h
target_include_directories(app PRIVATE ${CMAKE_CURRENT_SOURCE_DIR}
src/)
```

## Kconfig
```
config NIH_RPC_UART
	bool "NIH RPC over UART"
	default y
	select SERIAL
	select UART_INTERRUPT_DRIVEN
	select ASSERT
	select RING_BUFFER
	help
	  If enabled, selects UART as a transport layer for nRF RPC.

if NIH_RPC_UART
config NIH_RPC_UART_BUF_SIZE
	int "Buffer size for both the uart ringbuf and the packet buffer."
	default 2048
endif

source "Kconfig.zephyr"
```

## Kconfig.sysbuild
```
# Copyright 2023-2024 Nordic Semiconductor ASA
# SPDX-License-Identifier: Apache-2.0

source "share/sysbuild/Kconfig"

config NET_CORE_BOARD
	string
	default "nrf5340dk/nrf5340/cpunet" if $(BOARD) = "nrf5340dk"

config NET_CORE_IMAGE_HCI_IPC
	bool "HCI IPC image on network core"
	default y
	depends on NET_CORE_BOARD != ""
```

## prj.conf
```kconfig
# UART RPC kconfig
#----------------------
CONFIG_HEAP_MEM_POOL_SIZE=4096

CONFIG_THREAD_CUSTOM_DATA=y

# Move nRF RPC to UART instead of shared mem
CONFIG_NIH_RPC_UART=y

#----------------------

# Enable logging (and redirect printk to log output)
CONFIG_ASSERT=y
CONFIG_LOG=y
# CONFIG_LOG_PRINTK=y

# TODO: move that back to buffered
# CONFIG_LOG_MODE_IMMEDIATE=y
CONFIG_THREAD_NAME=y
CONFIG_LOG_THREAD_ID_PREFIX=y

# Free up UART for RPC usage
CONFIG_SERIAL=y
CONFIG_UART_CONSOLE=n
CONFIG_LOG_BACKEND_UART=n

# Use our NIH-RPC log backend
CONFIG_LOG_OUTPUT=y

# Logging on RTT is useful to debug NIH-RPC
CONFIG_LOG_BACKEND_RTT=n
# CONFIG_LOG_BACKEND_RTT=y
# CONFIG_USE_SEGGER_RTT=y
# CONFIG_SEGGER_RTT_BUFFER_SIZE_UP=8192
# # Always get the latest logs, even if not read yet
# CONFIG_LOG_BACKEND_RTT_MODE_OVERWRITE=y

# Sample configs
CONFIG_BT=y
CONFIG_BT_PERIPHERAL=y
CONFIG_BT_CENTRAL=y
CONFIG_BT_MAX_CONN=2
CONFIG_BT_DEVICE_NAME="pytest-adv"

CONFIG_BT_EXT_ADV=n
CONFIG_BT_USER_PHY_UPDATE=n

CONFIG_BT_RX_STACK_SIZE=2048
# Allow ozone to inspect thread states
CONFIG_THREAD_MONITOR=y
```

## prj_nrf5340dk_nrf5340_cpuapp.conf
```kconfig
# UART RPC kconfig
#----------------------
CONFIG_HEAP_MEM_POOL_SIZE=4096

CONFIG_THREAD_CUSTOM_DATA=y

CONFIG_NRF_RPC=y
CONFIG_NRF_RPC_CBOR=y
CONFIG_NRF_RPC_THREAD_STACK_SIZE=4096

# Move nRF RPC to UART instead of shared mem
CONFIG_NRF_RPC_UART=y

# Encode lists as indefinite, that way we avoid the need for
# ZCBOR backups when encoding.
# We will not need to manually do the allocation once this lands:
# https://github.com/nrfconnect/sdk-nrfxlib/pull/803
CONFIG_ZCBOR_CANONICAL=n
#----------------------

# Enable logging (and redirect printk to log output)
CONFIG_LOG=y
CONFIG_LOG_PRINTK=y
CONFIG_LOG_MODE_IMMEDIATE=y

# Free up UART for RPC usage
CONFIG_SERIAL=y
CONFIG_UART_CONSOLE=n
CONFIG_LOG_BACKEND_UART=n

# Enable logging on RTT
CONFIG_LOG_BACKEND_RTT=y
CONFIG_USE_SEGGER_RTT=y
CONFIG_SEGGER_RTT_BUFFER_SIZE_UP=8192
# Always get the latest logs, even if not read yet
CONFIG_LOG_BACKEND_RTT_MODE_OVERWRITE=y

# Hang the test instead of silently rebooting
CONFIG_RESET_ON_FATAL_ERROR=n

# Sample configs
CONFIG_BT=y
CONFIG_BT_PERIPHERAL=y
CONFIG_BT_OBSERVER=y
CONFIG_BT_DEVICE_NAME="pytest-adv"

# Match the BT RPC config
CONFIG_BT_USER_PHY_UPDATE=n
CONFIG_BT_SMP=n
CONFIG_BT_ECC=n
CONFIG_BT_EXT_ADV=n
CONFIG_BT_SETTINGS=n
CONFIG_BT_DEVICE_APPEARANCE=833
CONFIG_BT_MAX_PAIRED=2

CONFIG_BT_HCI=n
CONFIG_BT_RPMSG=n
CONFIG_BT_RPC=y
CONFIG_BT_RPC_STACK=y

# Uncomment to allow better debugging
# CONFIG_ZCBOR_VERBOSE=y
# CONFIG_NRF_RPC_LOG_LEVEL_DBG=y
# CONFIG_NRF_RPC_TR_LOG_LEVEL_DBG=y
# CONFIG_NRF_RPC_OS_LOG_LEVEL_DBG=y
```

## boards/nrf5340dk_nrf5340_cpuapp.conf
```kconfig
CONFIG_PARTITION_MANAGER_ENABLED=n
CONFIG_BOARD_ENABLE_CPUNET=y
```

## boards/nrf52840dk_nrf52840.overlay
```dts
&uart0 {
	compatible = "nordic,nrf-uarte";
	current-speed = <1000000>;
	status = "okay";
	hw-flow-control;
};
/ {
	chosen {
		zephyr,rpc-uart = &uart0;
	};
};
```

## boards/nrf5340dk_nrf5340_cpuapp.overlay
```dts
&uart0 {
	compatible = "nordic,nrf-uarte";
	current-speed = <1000000>;
	status = "okay";
	hw-flow-control;
};
/ {
	chosen {
		zephyr,rpc-uart = &uart0;
	};
};
```

## src/main.c
```c
/*
 * Copyright (c) 2022 Nordic Semiconductor ASA
 *
 * SPDX-License-Identifier: LicenseRef-Nordic-5-Clause
 */

#include <zephyr/kernel.h>
#include <zephyr/bluetooth/bluetooth.h>
#include <nih_rpc.h>

void evt_ready(void);
extern void register_handlers(void);

int main(void)
{
	printk("RPC testing app started [APP Core].\n");

	bt_enable(NULL);
	printk("bt enabled\n");

	register_handlers();

	nih_rpc_init();

	printk("RPC initialized\n");

	return 0;
}
```

## src/nih_rpc.c
```c
/*
 * Copyright (c) 2024 Nordic Semiconductor ASA
 *
 * SPDX-License-Identifier: LicenseRef-Nordic-5-Clause
 */
#include <errno.h>
#include <string.h>

#include <zephyr/kernel.h>
#include <zephyr/device.h>
#include <zephyr/drivers/uart.h>
#include <zephyr/sys/ring_buffer.h>

#include <zephyr/sys/__assert.h>
#include <nih_rpc.h>

#include <zephyr/logging/log.h>

/* the NIH-RPC logging backend will not be enabled if logging is enabled here
 * Unless you have unlimited stack of course.
 */
LOG_MODULE_REGISTER(nih_rpc, NIH_RPC_LOG_LEVEL);

// TODO: Use a buf pool depending on evt size
NET_BUF_POOL_DEFINE(rpc_pool, 50, 2048, 0, NULL);

nih_rpc_handler_t *rpc_cmd_handlers;
nih_rpc_handler_t *rpc_evt_handlers;

static char g_data[CONFIG_NIH_RPC_UART_BUF_SIZE];
static struct nih_rpc_uart g_uart_config;
static struct nih_rpc_uart_header g_uart_header;
RING_BUF_DECLARE(g_ringbuf, CONFIG_NIH_RPC_UART_BUF_SIZE);

struct net_buf *nih_rpc_alloc_buf(size_t size)
{
	struct net_buf *buf = net_buf_alloc(&rpc_pool, K_SECONDS(1));

	__ASSERT_NO_MSG(buf->size >= size);

	if (buf) {
		net_buf_reserve(buf, NIH_RPC_BUF_RESERVE);
	}

	return buf;
}

static int transport_send(struct nih_rpc_uart *uart_config, struct net_buf *buf);

/* TODO: clean this up */
static volatile bool _available = false;
bool nih_rpc_is_available(void)
{
	return _available;
}

int nih_rpc_send_rsp(struct net_buf *buf, uint16_t opcode)
{
	LOG_DBG("op %x", opcode);
	net_buf_push_le16(buf, opcode);
	net_buf_push_u8(buf, RPC_TYPE_RSP);

	if (!nih_rpc_is_available()) {
		LOG_ERR("RPC not initialized. Can't send RSP");
	}

	int err = transport_send(&g_uart_config, buf);

	net_buf_unref(buf);

	return err;
}

static int nih_rpc_send_init(struct net_buf *buf)
{
	LOG_DBG("send init pkt");
	net_buf_push_le16(buf, 0x1337);
	net_buf_push_u8(buf, RPC_TYPE_INIT);

	int err = transport_send(&g_uart_config, buf);

	net_buf_unref(buf);

	return err;
}

static int nih_rpc_send_initrsp(struct net_buf *buf)
{
	LOG_DBG("send init rsp pkt");
	net_buf_push_le16(buf, 0x1337);
	net_buf_push_u8(buf, RPC_TYPE_INITRSP);

	int err = transport_send(&g_uart_config, buf);

	net_buf_unref(buf);

	return err;
}

int nih_rpc_send_event(struct net_buf *buf, uint16_t opcode)
{
	LOG_DBG("op %x", opcode);
	net_buf_push_le16(buf, opcode);
	net_buf_push_u8(buf, RPC_TYPE_EVT);

	int err = transport_send(&g_uart_config, buf);

	net_buf_unref(buf);

	return err;
}

int nih_rpc_send_log(struct net_buf *buf)
{
	net_buf_push_le16(buf, 0); /* not used for now. Could be used for level? */
	net_buf_push_u8(buf, RPC_TYPE_LOG);

	int err = transport_send(&g_uart_config, buf);

	net_buf_unref(buf);

	return err;
}

void nih_rpc_register_cmd_handlers(nih_rpc_handler_t handlers[], size_t num)
{
	rpc_cmd_handlers = handlers;
}

/* TODO: remove unused code */
void nih_rpc_register_evt_handlers(nih_rpc_handler_t handlers[], size_t num)
{
	rpc_evt_handlers = handlers;
}

static int rpc_handle_buf(struct net_buf *buf, struct nih_rpc_uart *uart_config)
{
	struct net_buf *rsp_buf;

	uint8_t type = net_buf_pull_u8(buf);

	__ASSERT(type < RPC_TYPE_MAX, "Unkown packet type");
	__ASSERT(type != RPC_TYPE_RSP, "Target -> PC command direction not yet supported");

	uint16_t op = net_buf_pull_le16(buf);

	LOG_DBG("Got type %x opcode %x", type, op);

	switch (type) {
		case RPC_TYPE_INITRSP:
			LOG_INF("got init rsp pkt. channel is now open.");
			uart_config->state = NSTATE_INITIALIZED;
			_available = true;

			return 0;
		case RPC_TYPE_INIT:
			LOG_INF("got init rsp pkt. sending ACK.");

			rsp_buf = nih_rpc_alloc_buf(10);

			return nih_rpc_send_initrsp(rsp_buf);
		case RPC_TYPE_ACK:
			/* TODO: retry logic? or delay freeing the evt buffer
			 * until the ACK is received. Most likely, flow control
			 * in the target->pc direction will not be necessary or
			 * will rather happen on the UART layer.
			 */
			LOG_INF("got ack for op %x", op);
			return 0;
		case RPC_TYPE_CMD:
			__ASSERT(rpc_cmd_handlers, "No registered command handlers");
			__ASSERT(rpc_cmd_handlers[op], "No registered command handler for opcode %x", op);

			LOG_INF("got cmd for op %x", op);

			int ret = rpc_cmd_handlers[op](buf);
			if (ret) {
				LOG_ERR("Handler for %x returned %d", op, ret);
			}

			rsp_buf = nih_rpc_alloc_buf(10);

			net_buf_push_u8(rsp_buf, ret);

			LOG_INF("sending rsp %d for op %d", ret, op);

			return nih_rpc_send_rsp(rsp_buf, op);
		case RPC_TYPE_EVT:
			__ASSERT(rpc_evt_handlers, "No registered event handlers");
			__ASSERT(rpc_evt_handlers[op], "No registered event handler for opcode %x", op);
			return rpc_evt_handlers[op](buf);
		default:
			__ASSERT(0, "ohno");
			return -1;
	}
}

static int nih_rpc_uart_init(struct nih_rpc_uart *uart_config);

int nih_rpc_init(void)
{
	g_uart_config.packet = &g_data[0];
	g_uart_config.header = &g_uart_header;
	g_uart_config.ringbuf = &g_ringbuf;
	g_uart_config.uart = DEVICE_DT_GET(DT_CHOSEN(zephyr_rpc_uart));

	g_uart_config.state = NSTATE_UNINITIALIZED;

	k_mutex_init(&g_uart_config.mutex);

	int err = nih_rpc_uart_init(&g_uart_config);
	if (err) {
		return err;
	}

	struct net_buf *buf = nih_rpc_alloc_buf(10);

	/* send init event */
	return nih_rpc_send_init(buf);
}

/* BIG ASS COMMENT ******************************************************************************************************************************** */

static inline void cleanup_state(struct nih_rpc_uart *config)
{
	LOG_DBG("");
	memset(config->header, 0, sizeof(struct nih_rpc_uart_header));
	config->idx = 0;
}

static void process_ringbuf(struct nih_rpc_uart *uart_config);

static void rpc_tr_uart_handler(struct k_work *item)
{
	LOG_DBG("");

	struct nih_rpc_uart *uart_config =
		CONTAINER_OF(item, struct nih_rpc_uart, work);
	LOG_DBG("work %p", &uart_config->work);

	struct nih_rpc_uart_header *header = uart_config->header;

	__ASSERT_NO_MSG(uart_config->state != NSTATE_UNINITIALIZED);

	ring_buf_get(uart_config->ringbuf, uart_config->packet, header->len);
	LOG_HEXDUMP_DBG(uart_config->packet, header->len, "packet");

	struct net_buf buf;

	net_buf_simple_init_with_data(&buf.b, uart_config->packet, header->len);

	LOG_DBG("calling rx cb");
	/* We memcpy the data out because the packet might reside on the ringbuf
	 * boundary, and nrf-rpc can't handle that, it expects a single linear
	 * array.
	 */
	rpc_handle_buf(&buf, uart_config);
	LOG_DBG("rx cb returned");
	cleanup_state(uart_config);

	/* Re-trigger processing in case we have another packet pending. */
	process_ringbuf(uart_config);
}

/* False if header is invalid or incomplete
 * True if header complete and valid
 */
static bool build_header(struct nih_rpc_uart *uart_config)
{
	struct nih_rpc_uart_header *header = uart_config->header;

	__ASSERT_NO_MSG(header != NULL);

	if (uart_config->idx > 6) {
		/* Header is complete, the current byte doesn't belong to it */
		return true;
	}

	uint8_t byte;

	if (ring_buf_get(uart_config->ringbuf, &byte, 1) != 1) {
		return false;
	}

	if (uart_config->idx < 4) {
		if (byte != "UART"[uart_config->idx]) {
			return false;
		}
		/* If the rx char matches its required value, uart_config->idx will
		 * be incremented and parsing will continue in the next call.
		 * Else, we cleanup the state and return.
		 */
	} else if (uart_config->idx == 3) {
		/* Don't trigger a memset for each rx'd byte (that doesn't match
		 * the header).
		 */
		cleanup_state(uart_config);
	}

	switch (uart_config->idx) {
	case 4:
		header->len = byte;
		break;
	case 5:
		header->len += byte << 8;
		break;
	case 6:
		header->crc = byte;
		break;
	default:
		break;
	}

	LOG_DBG("byte[%d]: %x", uart_config->idx, byte);

	uart_config->idx++;
	return false;
}

static uint8_t compute_crc(struct nih_rpc_uart_header *header, struct ring_buf *buf)
{
	/* TODO: implement crc. could be crc8_ccitt() */
	return header->crc;
}

static void process_ringbuf(struct nih_rpc_uart *uart_config)
{
	struct nih_rpc_uart_header *header = uart_config->header;

	/* try to parse header */
	while (!ring_buf_is_empty(uart_config->ringbuf) &&
	       !build_header(uart_config)) {};

	/* receive the packet data */
	if (build_header(uart_config)) {
		if (ring_buf_size_get(uart_config->ringbuf) >= header->len) {
			if (compute_crc(header, uart_config->ringbuf) == header->crc) {
				LOG_DBG("submit to nrf-rpc");
				k_work_submit(&uart_config->work);
				/* LOG_DBG("early return"); */
				return;
			}
		}
	}
}

/*
 * Read any available characters from UART, and place them in a ring buffer. The
 * ring buffer is in turn processed by process_ringbuf().
 */
void serial_cb(const struct device *uart, void *user_data)
{
	struct nih_rpc_uart *uart_config = (struct nih_rpc_uart *)user_data;

	if (!uart_irq_update(uart)) {
		return;
	}

	while (uart_irq_rx_ready(uart)) {
		uint8_t byte = 0; /* Have to assign to stop GCC from whining */
		uart_fifo_read(uart, &byte, 1);
		uint32_t ret = ring_buf_put(uart_config->ringbuf, &byte, 1);
		(void)ret; /* Don't warn if logging is disabled */

		LOG_DBG("rx: %x, rb put %u", byte, ret);

		/* Only try to decode if wq item is not pending */
		if (!k_work_busy_get(&uart_config->work)) {
			process_ringbuf(uart_config);
		}
	}
}

static int nih_rpc_uart_init(struct nih_rpc_uart *uart_config)
{
	LOG_DBG("");

	k_work_init(&uart_config->work, rpc_tr_uart_handler);

	if (uart_config->state != NSTATE_UNINITIALIZED) {
		return 0;
	}

	/* Initialize UART driver */
	if (!device_is_ready(uart_config->uart)) {
		LOG_ERR("UART device not found!");
		return -EAGAIN;
	}

	uart_config->state = NSTATE_INITIALIZING;

	uart_irq_callback_user_data_set(uart_config->uart,
					serial_cb,
					(void *)uart_config);
	uart_irq_rx_enable(uart_config->uart);

	LOG_DBG("init ok");

	return 0;
}

static int transport_send(struct nih_rpc_uart *uart_config, struct net_buf *buf)
{
	LOG_DBG("");
	uint16_t length = buf->len;

	if (uart_config->state == NSTATE_UNINITIALIZED) {
		LOG_ERR("nRF RPC transport is not initialized");
		return -ENOTCONN;
	}

	/* FIXME: is this safe if called from the syswq with a UART driver that
	 * somehow executes stuff on the syswq?
	 */
	int err = k_mutex_lock(&uart_config->mutex, K_FOREVER);
	__ASSERT_NO_MSG(!err);

	LOG_DBG("Sending %u bytes", length);
	LOG_HEXDUMP_DBG(buf->data, length, "Data: ");

	/* Add UART transport header */
	uart_poll_out(uart_config->uart, 'U');
	uart_poll_out(uart_config->uart, 'A');
	uart_poll_out(uart_config->uart, 'R');
	uart_poll_out(uart_config->uart, 'T');
	/* Add length */
	uart_poll_out(uart_config->uart, 0xFF & length);
	uart_poll_out(uart_config->uart, 0xFF & (length >> 8));
	/* Add CRC (not computed for now) */
	uart_poll_out(uart_config->uart, 0);

	for (size_t i = 0; i < length; i++) {
		uart_poll_out(uart_config->uart, buf->data[i]);
	}

	LOG_DBG("exit");

	err = k_mutex_unlock(&uart_config->mutex);
	__ASSERT_NO_MSG(!err);

	return 0;
}
```

## src/nih_rpc.h
```c
/*
 * Copyright (c) 2022 Nordic Semiconductor ASA
 *
 * SPDX-License-Identifier: LicenseRef-Nordic-5-Clause
 */
/* TODO: naming n stuff */
#ifndef NIH_RPC_UART_H_
#define NIH_RPC_UART_H_

#include <zephyr/device.h>

#include <zephyr/sys/ring_buffer.h>
#include <zephyr/net/buf.h>

#include <stdbool.h>

enum nih_rpc_packet_types {
	RPC_TYPE_INIT = 0,
	RPC_TYPE_INITRSP,
	RPC_TYPE_CMD,
	RPC_TYPE_RSP,
	RPC_TYPE_EVT,
	RPC_TYPE_ACK,
	RPC_TYPE_ERR,
	RPC_TYPE_LOG,
	RPC_TYPE_MAX,
};

struct nih_rpc_header {
	uint8_t type;
	uint16_t opcode;
};

/* We have to use an additional header because the nRF RPC header
 * does not encode packet length information.
 */
struct nih_rpc_uart_header {
	char start[4];		/* spells U A R T */
	uint16_t len;
	uint8_t crc;		/* CRC of whole frame */
};

#define NIH_RPC_BUF_RESERVE (sizeof(struct nih_rpc_header) + sizeof(struct nih_rpc_uart_header))

enum nih_rpc_uart_state {
	NSTATE_RFU = 0,
	NSTATE_UNINITIALIZED,
	NSTATE_INITIALIZING,
	NSTATE_INITIALIZED,
	NSTATE_LAST,
};

struct nih_rpc_uart {
	const struct device *uart;

	/** Indicates if transport is already initialized. */
	enum nih_rpc_uart_state state;

	/* Current index, used when building header */
	uint8_t idx;

	struct nih_rpc_uart_header *header;

	/* ring buffer: stores all received uart data */
	struct ring_buf *ringbuf;

	/* packet buffer: stores only the packet to be sent to nRF RPC */
	char *packet;

	/* Thread-safety */
	struct k_mutex mutex;

	/* Dispatches callbacks into nRF RPC */
	struct k_work work;
};

typedef int (*nih_rpc_handler_t)(struct net_buf *buf);

int nih_rpc_init(void);
void nih_rpc_register_cmd_handlers(nih_rpc_handler_t handlers[], size_t num);
void nih_rpc_register_evt_handlers(nih_rpc_handler_t handlers[], size_t num);
int nih_rpc_send_rsp(struct net_buf *buf, uint16_t opcode);
int nih_rpc_send_event(struct net_buf *buf, uint16_t opcode);
int nih_rpc_send_log(struct net_buf *buf);
bool nih_rpc_is_available(void);
struct net_buf *nih_rpc_alloc_buf(size_t size);

#if defined(CONFIG_LOG_BACKEND_RTT)
#define NIH_RPC_LOG_LEVEL 3
#else
#define NIH_RPC_LOG_LEVEL 0
#endif

#endif /* NIH_RPC_UART_H_ */
```

## src/nih_rpc_log_backend.c
```c
/*
 * Copyright (c) 2024 Nordic Semiconductor ASA
 *
 * SPDX-License-Identifier: Apache-2.0
 */

/** @file
 * @brief NIH-RPC log backend implementation.
 */

#include <zephyr/logging/log_backend.h>
#include <zephyr/logging/log_core.h>
#include <zephyr/logging/log_output.h>
#include <zephyr/logging/log_backend_std.h>
#include <zephyr/sys/__assert.h>
#include <zephyr/net/buf.h>
#include <nih_rpc.h>

#define LOG_BUFFER_SIZE 512

/* TODO: kconfig for the buf size */
static uint8_t buf[LOG_BUFFER_SIZE];

static int _out(uint8_t *data, size_t length, void *ctx)
{
	/* TODO: store global buf in ctx */
	static struct net_buf *buf = NULL;
	int err;

	ARG_UNUSED(ctx);

	if (NIH_RPC_LOG_LEVEL != 0) {
		return length;
	}

	/* if no global buf, allocate one */
	if (!buf) {
		buf = nih_rpc_alloc_buf(LOG_BUFFER_SIZE);
	}

	if (!buf) {
		return length;
	}

	(void)net_buf_add_mem(buf, data, length);

	if (length == 1 && *data != '\n') {
		/* Sending a whole line -> less overhead */
		return length;
	}

	if (!nih_rpc_is_available()) {
		/* don't output lines until we are initialized */
		net_buf_unref(buf);
		length = 0;
		goto end;
	}

	err = nih_rpc_send_log(buf);
	__ASSERT_NO_MSG(!err);
end:
	buf = NULL;

	return length;
}

LOG_OUTPUT_DEFINE(log_output_nih, _out, buf, sizeof(buf));

static bool is_uart_or_nih_rpc(uint32_t source)
{
	/* TODO: implement */
	return false;
}

static void log_backend_nih_process(const struct log_backend *const backend,
				    union log_msg_generic *msg)
{
	uint32_t source_id;
	const void *source = msg->log.hdr.source;

	if (source == NULL) {
		source_id = 0;
	} else {
		source_id = IS_ENABLED(CONFIG_LOG_RUNTIME_FILTERING) ?
		    log_dynamic_source_id((struct log_source_dynamic_data *)source) :
		    log_const_source_id((const struct log_source_const_data *)source);
	}

	/* Discard logs coming from NIH-RPC or tranport (UART driver) domain */
	if (is_uart_or_nih_rpc(source_id)) {
		return;
	}

	uint32_t flags = log_backend_std_get_flags();

	log_format_func_t log_output_func = log_format_func_t_get(LOG_OUTPUT_TEXT);

	log_output_func(&log_output_nih, &msg->log, flags);
}

static void log_backend_nih_init(struct log_backend const *const backend)
{
	/* NIH-RPC has its own auto-init mechanism */
}

static void log_backend_nih_panic(struct log_backend const *const backend)
{
	log_output_flush(&log_output_nih);
}

static void dropped(const struct log_backend *const backend, uint32_t cnt)
{
	ARG_UNUSED(backend);

	/* TODO: use log_output_dropped_process? */
	log_backend_std_dropped(&log_output_nih, cnt);
}

const struct log_backend_api log_backend_nih_api = {
	.process = log_backend_nih_process,
	.panic = log_backend_nih_panic,
	.init = log_backend_nih_init,
	.dropped = IS_ENABLED(CONFIG_LOG_MODE_IMMEDIATE) ? NULL : dropped,
};

LOG_BACKEND_DEFINE(log_backend_nih, log_backend_nih_api, true);
```

## src/rpc_handler.c
```c
/*
 * Copyright (c) 2022 Nordic Semiconductor ASA
 *
 * SPDX-License-Identifier: LicenseRef-Nordic-5-Clause
 */
#include <errno.h>
#include <zephyr/init.h>
#include <string.h>
#include <stdint.h>

#include <nih_rpc.h>

#include <zephyr/bluetooth/bluetooth.h>
#include <zephyr/bluetooth/addr.h>
#include <zephyr/bluetooth/conn.h>

#include "test_rpc_opcodes.h"

#include <zephyr/logging/log.h>
#include <zephyr/logging/log_ctrl.h>

LOG_MODULE_REGISTER(rpc_handler, 3);

void evt_ready(void)
{
	struct net_buf *buf = nih_rpc_alloc_buf(100);

	/* This event doesn't have any data. */
	nih_rpc_send_event(buf, RPC_EVENT_READY);
}

struct _bt_conn_le_create_param {
	uint32_t options;
	uint16_t interval;
	uint16_t window;
	uint16_t interval_coded;
	uint16_t window_coded;
	uint16_t timeout;
} __packed;

struct cmd_connect {
	bt_addr_le_t peer;
	struct _bt_conn_le_create_param params;
} __packed;

static int handler_connect(struct net_buf *buf)
{
	LOG_DBG("");

	struct cmd_connect *p = net_buf_pull_mem(buf, sizeof(struct cmd_connect));

	struct bt_conn_le_create_param params;

	params.options = p->params.options;
	params.interval = p->params.interval;
	params.window = p->params.window;
	params.interval_coded = p->params.interval_coded;
	params.window_coded = p->params.window_coded;
	params.timeout = p->params.timeout;

	char addr_str[BT_ADDR_LE_STR_LEN] = {0};
	bt_addr_le_to_str(&p->peer, addr_str, BT_ADDR_LE_STR_LEN);

	LOG_INF("connecting to: %s options %x interval %d window %d timeout %d", addr_str,
		p->params.options, p->params.interval, p->params.window, p->params.timeout);


	struct bt_conn *conn;

	// TODO: does this leak? conn ref. Make a test for it.
	int err = bt_conn_le_create(&p->peer, &params, BT_LE_CONN_PARAM_DEFAULT, &conn);
	LOG_INF("bt_conn_le_create (%d)", err);

	return err;
}

static int handler_disconnect(struct net_buf *buf)
{
	LOG_DBG("");

	return 0;
}

static const struct bt_data ad[] = {
	BT_DATA_BYTES(BT_DATA_FLAGS, (BT_LE_AD_GENERAL | BT_LE_AD_NO_BREDR)),
	BT_DATA(BT_DATA_NAME_COMPLETE, CONFIG_BT_DEVICE_NAME, sizeof(CONFIG_BT_DEVICE_NAME) - 1),
};

static int handler_advertise(struct net_buf *buf)
{
	LOG_DBG("");

	int err = bt_le_adv_start(BT_LE_ADV_CONN, ad, ARRAY_SIZE(ad), NULL, 0);
	LOG_INF("bt_le_adv_start: %d", err);

	return err;
}

/* The event contains this + the `ad` data */
struct evt_device_found {
	bt_addr_le_t addr;
	int8_t rssi;
	uint8_t type;
	uint16_t ad_length;
} __packed;

static int8_t rssi_threshold; /* set by `handler_scan` */

static void device_found(const bt_addr_le_t *addr,
			 int8_t rssi,
			 uint8_t type,
			 struct net_buf_simple *ad)
{
	if (type == BT_GAP_ADV_TYPE_ADV_IND && rssi > rssi_threshold) {
		/* Log the device */
		char dev[BT_ADDR_LE_STR_LEN];

		LOG_HEXDUMP_ERR(addr, sizeof(bt_addr_le_t), "addr:");

		bt_addr_le_to_str(addr, dev, sizeof(dev));
		LOG_INF("[DEVICE]: %s, AD evt type %u, AD data len %u, RSSI %i",
			dev, type, ad->len, rssi);

		struct net_buf *buf = nih_rpc_alloc_buf(sizeof(struct evt_device_found) + ad->len);

		struct evt_device_found *evt = net_buf_add(buf, sizeof(struct evt_device_found));

		evt->rssi = rssi;
		evt->type = type;
		evt->ad_length = ad->len;
		bt_addr_le_copy(&evt->addr, addr);

		(void)net_buf_add_mem(buf, ad->data, ad->len);

		nih_rpc_send_event(buf, RPC_EVENT_BT_SCAN_REPORT);
	}
}

struct cmd_scan_start {
	int8_t rssi_threshold;
} __packed;

static int handler_scan_start(struct net_buf *buf)
{
	LOG_DBG("");
	int err;
	struct cmd_scan_start *params = net_buf_pull_mem(buf, sizeof(struct cmd_scan_start));

	/* Store threshold for scanned devices */
	rssi_threshold = params->rssi_threshold;
	LOG_INF("RSSI threshold %d", params->rssi_threshold);

	struct bt_le_scan_param scan_param = {
		.type       = BT_LE_SCAN_TYPE_ACTIVE,
		.options    = BT_LE_SCAN_OPT_NONE,
		.interval   = BT_GAP_SCAN_FAST_INTERVAL,
		.window     = BT_GAP_SCAN_FAST_WINDOW,
	};

	err = bt_le_scan_start(&scan_param, device_found);
	LOG_INF("bt_le_scan_start: %d", err);

	return err;
}

static int handler_scan_stop(struct net_buf *buf)
{
	LOG_DBG("");

	int err = bt_le_scan_stop();
	LOG_INF("bt_le_scan_stop: %d", err);

	return err;
}

static int handler_k_oops(struct net_buf *buf)
{
	LOG_DBG("");

	/* Trigger a panic */
	LOG_INF("Triggering panic");
	k_oops();

	return 0;
}

struct evt_connected {
	bt_addr_le_t addr;
	uint8_t conn_err;
} __packed;

static void connected(struct bt_conn *conn, uint8_t conn_err)
{
	LOG_INF("connected");

	char str[BT_ADDR_LE_STR_LEN];
	const bt_addr_le_t *addr = bt_conn_get_dst(conn);

	bt_addr_le_to_str(addr, str, sizeof(str));

	struct net_buf *buf = nih_rpc_alloc_buf(sizeof(struct evt_connected));
	struct evt_connected *evt = (struct evt_connected*)buf->data;

	if (conn_err) {
		LOG_INF("Failed to connect to %s (%u)", str, conn_err);
	} else {
		LOG_INF("Connected: %s", str);
	}

	bt_addr_le_copy(&evt->addr, addr);
	evt->conn_err = conn_err;

	(void)net_buf_push(buf, sizeof(struct evt_connected));

	nih_rpc_send_event(buf, RPC_EVENT_BT_CONNECTED);

	bt_conn_unref(conn);
}

BT_CONN_CB_DEFINE(conn_callbacks) = {
	.connected = connected,
};

/* TODO: make this a system command */
static int handler_flush_logs(struct net_buf *buf)
{
	LOG_DBG("");

	while (log_process());

	return 0;
}

void register_handlers(void)
{
	static nih_rpc_handler_t cmd_handlers[RPC_CMD_MAX];

	cmd_handlers[RPC_CMD_BT_ADVERTISE] = handler_advertise;
	cmd_handlers[RPC_CMD_FLUSH_LOGS] = handler_flush_logs;
	cmd_handlers[RPC_CMD_BT_SCAN] = handler_scan_start;
	cmd_handlers[RPC_CMD_BT_SCAN_STOP] = handler_scan_stop;
	cmd_handlers[RPC_CMD_BT_CONNECT] = handler_connect;
	cmd_handlers[RPC_CMD_BT_DISCONNECT] = handler_disconnect;
	cmd_handlers[RPC_CMD_K_OOPS] = handler_k_oops;

	nih_rpc_register_cmd_handlers(cmd_handlers, RPC_CMD_MAX);
}
```

## src/rpc_handler.h
```c
/*
 * Copyright (c) 2022 Nordic Semiconductor ASA
 *
 * SPDX-License-Identifier: LicenseRef-Nordic-5-Clause
 */

#ifndef RPC_HANDLER_H_
#define RPC_HANDLER_H_

/* Signal to the PC that we're ready to accept commands. */
void evt_ready(void);

#endif // RPC_HANDLER_H_
```
